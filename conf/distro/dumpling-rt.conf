## conf/distro/dumpling-rt.conf
```bitbake
require dumpling.conf

DISTRO = "dumpling-rt"
DISTRO_NAME = "Dumpling RT (TQ Systems Dumpling RT Distribution)"

PREFERRED_PROVIDER_virtual/kernel = "linux-rt-tq"
```
